## meta-coldnew-core/conf/layer.conf
```bitbake
# We have a conf and classes directory, add to BBPATH
BBPATH .= ":${LAYERDIR}"

# We have recipes-* directories, add to BBFILES
BBFILES += "${LAYERDIR}/recipes-*/*/*.bb \
	${LAYERDIR}/recipes-*/*/*.bbappend"

BBFILE_COLLECTIONS += "coldnew-core"
BBFILE_PATTERN_coldnew-core = "^${LAYERDIR}/"
BBFILE_PRIORITY_coldnew-core = "6"
```

## meta-coldnew-core/conf/machine/qemuarmv7.conf
```bitbake
#@TYPE: Machine
#@NAME: qemu armv7a machine
#@DESCRIPTION: Generic qemuarmv7a machine for building PLC driver

DEFAULTTUNE ?= "armv7ahf-neon"

require conf/machine/include/arm/arch-armv7a.inc

PREFERRED_PROVIDER_virtual/xserver ?= "xserver-xorg"

XSERVER ?= "xserver-xorg \
            mesa-driver-swrast \
            xf86-input-evdev \
            xf86-input-mouse \
            xf86-video-fbdev \
            xf86-input-keyboard"

MACHINE_FEATURES = "usbgadget usbhost vfat alsa"

# Ship all kernel modules by default
MACHINE_EXTRA_RRECOMMENDS = " kernel-modules"

# Allow for MMC booting (required by the NAND-less)
EXTRA_IMAGEDEPENDS += ""

IMAGE_FSTYPES += "tar.bz2 ext3"

# 2.6.37 and later kernels use OMAP_SERIAL, ttyO2
# earlier kernels use ttyS2
SERIAL_CONSOLE = "115200 ttyO2"

PREFERRED_PROVIDER_virtual/kernel ?= "linux-yocto"

KERNEL_IMAGETYPE = "zImage"

UBOOT_MACHINE = "ca9x4_ct_vxp_config"
UBOOT_ENTRYPOINT = "0x80008000"
UBOOT_LOADADDRESS = "0x80008000"
```

## meta-coldnew-fsl/conf/layer.conf
```bitbake
# We have a conf and classes directory, add to BBPATH
BBPATH .= ":${LAYERDIR}"

# We have recipes-* directories, add to BBFILES
BBFILES += "${LAYERDIR}/recipes-*/*/*.bb \
        ${LAYERDIR}/recipes-*/*/*.bbappend"

BBFILE_COLLECTIONS += "coldnew-fsl"
BBFILE_PATTERN_coldnew-fsl := "^${LAYERDIR}/"
BBFILE_PRIORITY_coldnew-fsl = "6"
```
